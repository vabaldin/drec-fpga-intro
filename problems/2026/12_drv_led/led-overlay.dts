/dts-v1/;
/plugin/;

/ {
    fragment@0 {
        target-path = "/";
        __overlay__ {
            #address-cells = <1>;
            #size-cells = <1>;

            led@43c00000 {
                compatible = "drec,axil-led";
                reg = <0x43c00000 0x10000>;
            };
        };
    };
};
